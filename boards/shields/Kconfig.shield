## boards/shields/Kconfig.shield
```kconfig
# No whitespace after the comma or in the keyboard name!
config SHIELD_KEEBOARD_DONGLE
    def_bool $(shields_list_contains,keeboard_dongle)
```

## boards/shields/ny_keyboard/Kconfig.shield
```kconfig
# No whitespace after the comma or in the keyboard name!
config SHIELD_MY_KEYBOARD_DONGLE
    def_bool $(shields_list_contains,my_keyboard_dongle)
```

## config/Kconfig
```kconfig
config ZMK_DISPLAY_STATUS_SCREEN_CUSTOM
	bool "Enable custom status screen with bongo cat and position display"
	depends on ZMK_DISPLAY
	default y
	help
	  This option enables a custom status screen with a bongo cat animation
	  that shows the current key position when keys are pressed.
```
